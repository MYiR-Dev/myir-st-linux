// SPDX-License-Identifier: (GPL-2.0-only OR BSD-3-Clause)
/*
 * Copyright (C) MYiR 2024 - All Rights Reserved
 */

/dts-v1/;

#define		LVDS_7INCH_PANEL		1
#define		ETH_SWITCH_ENABLE  		0


#include "myb-stm32mp257x-base.dtsi"
#include "myb-stm32mp257x-2GB-resmem.dtsi"
#include "myb-stm32mp257x-ethswitch.dtsi"


/ {
	model = "MYiR STM32MP257x Evaluation Board 2";
	compatible = "myir,myb-stm32mp257x", "st,stm32mp257f-ev1", "st,stm32mp257";

	chosen {
		stdout-path = "serial0:115200n8";
	};

	memory@80000000 {
		device_type = "memory";
		reg = <0x0 0x80000000 0x0 0x80000000>;
	};

};

